## CMakeLists.txt
```
cmake_minimum_required(VERSION 3.20.0)
find_package(Zephyr REQUIRED HINTS $ENV{ZEPHYR_BASE})

project(BT_DISPLAY)

target_sources(app PRIVATE src/main.c src/DCLK_client.c src/Interface_display.c)
```

## prj.conf
```kconfig
CONFIG_BT_DEVICE_NAME="DCLK_Display_1"

CONFIG_BT_MAX_CONN=1
CONFIG_BT_DEBUG_LOG=y
CONFIG_LOG=y
CONFIG_PRINTK=y



# Enable the BLE stack with GATT Client configuration
CONFIG_BT=y
CONFIG_BT_CENTRAL=y
CONFIG_BT_SMP=y
CONFIG_BT_GATT_CLIENT=y
CONFIG_BT_FILTER_ACCEPT_LIST=y 
#CONFIG_BT_SIGNING=y
#CONFIG_BT_FIXED_PASSKEY=y

CONFIG_BT_PRIVACY=y
CONFIG_BT_BONDABLE=y

# Enable the BLE modules from NCS
CONFIG_BT_SCAN=y
CONFIG_BT_SCAN_FILTER_ENABLE=y
CONFIG_BT_SCAN_UUID_CNT=1
CONFIG_BT_GATT_DM=y
CONFIG_HEAP_MEM_POOL_SIZE=2048

# This example requires more workqueue stack
CONFIG_SYSTEM_WORKQUEUE_STACK_SIZE=2048

# Enable bonding
CONFIG_BT_SETTINGS=y
CONFIG_FLASH=y
CONFIG_FLASH_PAGE_LAYOUT=y
CONFIG_FLASH_MAP=y
CONFIG_NVS=y
CONFIG_SETTINGS=y




CONFIG_LED_STRIP=y
CONFIG_LED_STRIP_LOG_LEVEL_DBG=y
CONFIG_WS2812_STRIP=y
CONFIG_SPI=y
CONFIG_WS2812_STRIP_SPI=y
```

## prjcopy.conf
```kconfig
CONFIG_BT_DEVICE_NAME="DCLK_2"

CONFIG_BT_MAX_CONN=1

CONFIG_LOG=y
CONFIG_PRINTK=y

CONFIG_USB_DEVICE_STACK=y
CONFIG_USB_DEVICE_PRODUCT="DISPLAY_USB"
CONFIG_USB_DEVICE_PID=0x0004
CONFIG_USB_DEVICE_INITIALIZE_AT_BOOT=n

CONFIG_SERIAL=y
CONFIG_CONSOLE=y
CONFIG_UART_CONSOLE=y
CONFIG_UART_LINE_CTRL=y

CONFIG_SYS_CLOCK_TICKS_PER_SEC=128

# Enable the BLE stack with GATT Client configuration
CONFIG_BT=y
CONFIG_BT_CENTRAL=y
CONFIG_BT_SMP=y
CONFIG_BT_GATT_CLIENT=y

# Enable the BLE modules from NCS
CONFIG_BT_SCAN=y
CONFIG_BT_SCAN_FILTER_ENABLE=y
CONFIG_BT_SCAN_UUID_CNT=1
CONFIG_BT_GATT_DM=y
CONFIG_HEAP_MEM_POOL_SIZE=2048

CONFIG_BT_FIXED_PASSKEY=y
# This example requires more workqueue stack
CONFIG_SYSTEM_WORKQUEUE_STACK_SIZE=2048

# Enable bonding
CONFIG_BT_SETTINGS=y
CONFIG_FLASH=y
CONFIG_FLASH_PAGE_LAYOUT=y
CONFIG_FLASH_MAP=y
CONFIG_NVS=y
CONFIG_SETTINGS=y
```

## src/main.c
```c
/*
 * Copyright (c) 2023 Nordic Semiconductor ASA
 *
 * SPDX-License-Identifier: Apache-2.0
 */

#include <zephyr/bluetooth/bluetooth.h>
#include <zephyr/bluetooth/conn.h>
#include <zephyr/bluetooth/gatt.h>
#include <zephyr/bluetooth/uuid.h>
#include <zephyr/sys/util.h>
#include <zephyr/logging/log.h>
#include "DCLK_client.h"

#include "Interface_display.h"

LOG_MODULE_REGISTER(Display_app, CONFIG_LOG_DEFAULT_LEVEL);

/*DCLK Client Service and BLE*/

static uint8_t app_clock_cb(uint32_t data)
{
	LOG_INF("DCLK - Clock = %d ms", data);
	return BT_GATT_ITER_CONTINUE;
}
static uint8_t app_state_cb(uint8_t data)
{
	LOG_INF("DCLK - State = %d", data);
	return BT_GATT_ITER_CONTINUE;
}

static void unsubscribed(struct bt_gatt_subscribe_params *params)
{
	LOG_INF("unsub cb");
	return BT_GATT_ITER_CONTINUE;
}

static struct dclk_client_cb app_callbacks = {
	.received_clock = app_clock_cb,
	.received_state = app_state_cb,
	.unsubscribed = unsubscribed,
};

static uint8_t pair_cb(void)
{
	LOG_INF("Allow pairing");
	dclk_pairing(true);
}
static uint8_t user_cb(void)
{
}

static struct interface_cb inter_callbacks = {
	.pair_cb = pair_cb,
	.user_cb = user_cb,
};

int main(void)
{
	LOG_INF("DCLK_Display initialized\n");

	int err = interface_init(&inter_callbacks);
	if (err)
	{
		printk("Interface init failed (err %d)\n", err);
		return;
	}

	err = dclk_client_init(&app_callbacks, 123456);
	if (err)
	{
		printk("Failed to init LBS (err:%d)\n", err);
		return;
	}
	LOG_INF("Bluetooth initialized\n");

	//dclk_pairing(true);

	while (1)
	{
		k_sleep(K_FOREVER);
	}

	return 0;
}
```

## src/DCLK_client.c
```c
#include <zephyr/types.h>
#include <stddef.h>
#include <zephyr/sys/util.h>

#include <zephyr/bluetooth/bluetooth.h>
#include <zephyr/bluetooth/hci.h>
#include <zephyr/bluetooth/conn.h>
#include <zephyr/bluetooth/uuid.h>
#include <zephyr/bluetooth/gatt.h>
#include <zephyr/sys/byteorder.h>
#include <bluetooth/gatt_dm.h>

#include <zephyr/settings/settings.h>

#include <zephyr/logging/log.h>

#include "DCLK_client.h"

// static unsigned int display_passkey = 123456;

static struct bt_conn *DCLK_C_conn;
struct dclk_client_t DCLK_client;

#define BT_UUID_DCLK BT_UUID_DECLARE_128(BT_UUID_DCLK_VAL)
#define BT_UUID_DCLK_VAL BT_UUID_128_ENCODE(0x00001553, 0x1212, 0xefde, 0x1523, 0x785feabcd123)

struct bt_conn_le_create_param *create_params =
	BT_CONN_LE_CREATE_PARAM(
		BT_CONN_LE_OPT_CODED,
		BT_GAP_SCAN_FAST_INTERVAL,
		BT_GAP_SCAN_FAST_INTERVAL);
// #define LOG_MODULE_NAME DCLK_CLIENT
LOG_MODULE_DECLARE(Display_app, LOG_LEVEL_DBG);

enum
{
	DCLK_INITIALIZED,
	DCLK_CLOCK_NOTIF_ENABLED,
	DCLK_STATE_NOTIF_ENABLED
};

/*




*/
/*SUBSCRIPTIONS*/

void stop_auto_connection(void)
{
	int err = bt_scan_stop();
	// int err = bt_conn_create_auto_stop();
	if (err)
	{
		LOG_ERR("Failed to stop connection err= %d", err);
	}
	return;
}

void start_auto_connection(void)
{

	int err = bt_scan_start(BT_SCAN_TYPE_SCAN_ACTIVE);

	// int err = bt_conn_le_create_auto(create_params,
	// 								 BT_LE_CONN_PARAM_DEFAULT);

	if (err)
	{
		LOG_ERR("Failed to start connection err= %d", err);
	}
	LOG_INF("Auto Connection Active");
	return;
}

static uint8_t on_received(struct bt_conn *conn,
						   struct bt_gatt_subscribe_params *params,
						   const void *data, uint16_t length)
{
	if (!data)
	{
		DCLK_client.cb.unsubscribed(params);

		return BT_GATT_ITER_STOP;
	}

	if (params->value_handle == DCLK_client.dclock_notif_params.value_handle)
	{
		// LOG_INF("D_CLOCK updated");
		if (DCLK_client.cb.received_clock)
		{
			return DCLK_client.cb.received_clock(*(uint32_t *)data);
		}
	}
	else if (params->value_handle == DCLK_client.dstate_notif_params.value_handle)
	{
		// LOG_INF("D_STATE updated");
		if (DCLK_client.cb.received_state)
		{
			return DCLK_client.cb.received_state(*(uint8_t *)data);
		}
	}
	return BT_GATT_ITER_CONTINUE;
}

int dclk_client_subscribe(struct dclk_client_t *DCLK_c)
{
	int err;

	atomic_set_bit(&DCLK_c->conn_state, DCLK_CLOCK_NOTIF_ENABLED);

	LOG_DBG("Subsribing");
	DCLK_c->dclock_notif_params.notify = on_received;
	DCLK_c->dclock_notif_params.value = BT_GATT_CCC_NOTIFY;
	DCLK_c->dclock_notif_params.value_handle = DCLK_c->handles.dclock;
	DCLK_c->dclock_notif_params.ccc_handle = DCLK_c->handles.dclock_ccc;
	atomic_set_bit(DCLK_c->dclock_notif_params.flags,
				   BT_GATT_SUBSCRIBE_FLAG_VOLATILE);

	err = bt_gatt_subscribe(DCLK_c->conn, &DCLK_c->dclock_notif_params);
	if (err)
	{
		LOG_ERR("Subscribe DCLOCK failed (err %d)", err);
		atomic_clear_bit(&DCLK_c->conn_state, DCLK_CLOCK_NOTIF_ENABLED);
	}
	else
	{
		LOG_DBG("[SUBSCRIBED DCLOCK]");
	}

	DCLK_c->dstate_notif_params.notify = on_received;
	DCLK_c->dstate_notif_params.value = BT_GATT_CCC_NOTIFY;
	DCLK_c->dstate_notif_params.value_handle = DCLK_c->handles.dstate;
	DCLK_c->dstate_notif_params.ccc_handle = DCLK_c->handles.dstate_ccc;
	atomic_set_bit(DCLK_c->dstate_notif_params.flags,
				   BT_GATT_SUBSCRIBE_FLAG_VOLATILE);

	err = bt_gatt_subscribe(DCLK_c->conn, &DCLK_c->dstate_notif_params);
	if (err)
	{
		LOG_ERR("Subscribe DSTATE failed (err %d)", err);
		atomic_clear_bit(&DCLK_c->conn_state, DCLK_STATE_NOTIF_ENABLED);
	}
	else
	{
		LOG_DBG("[SUBSCRIBED DCLOCK]");
	}

	return err;
}

int dclk_client_handles_assign(struct bt_gatt_dm *dm,
							   struct dclk_client_t *DCLK_c)
{

	const struct bt_gatt_dm_attr *gatt_service_attr =
		bt_gatt_dm_service_get(dm);
	const struct bt_gatt_service_val *gatt_service =
		bt_gatt_dm_attr_service_val(gatt_service_attr);
	const struct bt_gatt_dm_attr *gatt_chrc;
	const struct bt_gatt_dm_attr *gatt_desc;

	if (bt_uuid_cmp(gatt_service->uuid, BT_UUID_DCLK))
	{
		LOG_INF("Failed");
		return -ENOTSUP;
	}
	LOG_INF("Getting handles from DCLK service.");
	memset(&DCLK_c->handles, 0xFF, sizeof(DCLK_c->handles));

	/* DCLK dclock Characteristic */
	gatt_chrc = bt_gatt_dm_char_by_uuid(dm, BT_UUID_DCLK_CLOCK);
	if (!gatt_chrc)
	{
		LOG_ERR("Missing DCLK dclock characteristic.");
		return -EINVAL;
	}

	/* DCLK dclock */
	gatt_desc = bt_gatt_dm_desc_by_uuid(dm, gatt_chrc, BT_UUID_DCLK_CLOCK);
	if (!gatt_desc)
	{
		LOG_ERR("Missing DCLK dclock value descriptor in characteristic.");
		return -EINVAL;
	}
	LOG_INF("Found handle for DCLK dclock characteristic.");
	DCLK_c->handles.dclock = gatt_desc->handle;

	/* DCLK dclock CCC */
	gatt_desc = bt_gatt_dm_desc_by_uuid(dm, gatt_chrc, BT_UUID_GATT_CCC);
	if (!gatt_desc)
	{
		LOG_ERR("Missing DCLK dclock CCC in characteristic.");
		return -EINVAL;
	}
	LOG_INF("Found handle for CCC of DCLK dclock characteristic.");
	DCLK_c->handles.dclock_ccc = gatt_desc->handle;

	/* DCLK dstate Characteristic */
	gatt_chrc = bt_gatt_dm_char_by_uuid(dm, BT_UUID_DCLK_STATE);
	if (!gatt_chrc)
	{
		LOG_ERR("Missing DCLK dstate characteristic.");
		return -EINVAL;
	}

	/* DCLK dstate */
	gatt_desc = bt_gatt_dm_desc_by_uuid(dm, gatt_chrc, BT_UUID_DCLK_STATE);
	if (!gatt_desc)
	{
		LOG_ERR("Missing DCLK dclock value descriptor in characteristic.");
		return -EINVAL;
	}
	LOG_INF("Found handle for DCLK dstate characteristic.");
	DCLK_c->handles.dstate = gatt_desc->handle;

	/* DCLK dstate CCC */
	gatt_desc = bt_gatt_dm_desc_by_uuid(dm, gatt_chrc, BT_UUID_GATT_CCC);
	if (!gatt_desc)
	{
		LOG_ERR("Missing DCLK dclock CCC in characteristic.");
		return -EINVAL;
	}
	LOG_INF("Found handle for CCC of DCLK dstate characteristic.");
	DCLK_c->handles.dstate_ccc = gatt_desc->handle;

	/* Assign connection instance. */
	DCLK_c->conn = bt_gatt_dm_conn_get(dm);
	return 0;
}

static void discovery_complete(struct bt_gatt_dm *dm,
							   void *context)
{
	LOG_INF("Service discovery completed");
	struct dclk_client_t *DCLK = context;

	dclk_client_handles_assign(dm, DCLK);
	LOG_DBG("Attempting to Subscribe");
	dclk_client_subscribe(DCLK);

	bt_gatt_dm_data_release(dm);
}

static void discovery_service_not_found(struct bt_conn *conn,
										void *context)
{
	LOG_INF("Service not found");
}

static void discovery_error(struct bt_conn *conn,
							int err,
							void *context)
{
	LOG_WRN("Error while discovering GATT database: (%d)", err);
}

struct bt_gatt_dm_cb discovery_cb = {
	.completed = discovery_complete,
	.service_not_found = discovery_service_not_found,
	.error_found = discovery_error,
};

static void gatt_discover(struct bt_conn *conn)
{
	int err;

	err = bt_gatt_dm_start(conn,
						   BT_UUID_DCLK,
						   &discovery_cb,
						   &DCLK_client);
	if (err)
	{
		LOG_ERR("could not start the discovery procedure, error "
				"code: %d",
				err);
	}
}

/*




*/
/*CONNECTIONS*/

static void connected(struct bt_conn *conn, uint8_t conn_err)
{

	LOG_INF("Connected");

	char addr[BT_ADDR_LE_STR_LEN];

	bt_addr_le_to_str(bt_conn_get_dst(conn), addr, sizeof(addr));

	if (conn_err)
	{
		LOG_INF("Failed to connect to %s (%u)\n", addr, conn_err);

		bt_conn_unref(DCLK_C_conn);
		DCLK_C_conn = NULL;

		start_auto_connection();
		return;
	}

	if (conn != DCLK_C_conn)
	{
		LOG_WRN("Wrong connection object!");
		return;
	}

	int err;

	err = bt_conn_set_security(conn, BT_SECURITY_L4);
	if (err)
	{
		LOG_WRN("Failed to set security: %d", err);
	}
	else
	{

		LOG_INF("Security Set");
	}

	gatt_discover(conn);
}

static void disconnected(struct bt_conn *conn, uint8_t reason)
{
	int err;

	char addr[BT_ADDR_LE_STR_LEN];

	if (conn != DCLK_C_conn)
	{
		LOG_WRN("Wrong connection object!");
		return;
	}

	bt_addr_le_to_str(bt_conn_get_dst(conn), addr, sizeof(addr));

	printk("Disconnected: %s (reason 0x%02x)\n", addr, reason);

	bt_conn_unref(DCLK_C_conn);
	DCLK_C_conn = NULL;

	start_auto_connection();
	if (err)
	{
		LOG_ERR("Scanning failed to start (err %d)",
				err);
	}
}

static void security_changed(struct bt_conn *conn, bt_security_t level,
							 enum bt_security_err err)
{
	char addr[BT_ADDR_LE_STR_LEN];

	bt_addr_le_to_str(bt_conn_get_dst(conn), addr, sizeof(addr));

	if (!err)
	{
		LOG_INF("Security changed: %s level %u", addr, level);
	}
	else
	{
		LOG_WRN("Security failed: %s level %u err %d", addr,
				level, err);
	}
}

BT_CONN_CB_DEFINE(conn_callbacks) = {
	.connected = connected,
	.disconnected = disconnected,
	.security_changed = security_changed,
};

/*




*/
/*PAIRING*/
static void pairing_complete(struct bt_conn *conn, bool bonded)
{
	char addr[BT_ADDR_LE_STR_LEN];

	bt_addr_le_to_str(bt_conn_get_dst(conn), addr, sizeof(addr));

	LOG_INF("Pairing completed: %s, bonded: %d", addr, bonded);
}

static void pairing_failed(struct bt_conn *conn, enum bt_security_err reason)
{
	char addr[BT_ADDR_LE_STR_LEN];

	bt_addr_le_to_str(bt_conn_get_dst(conn), addr, sizeof(addr));

	LOG_WRN("Pairing failed conn: %s, reason %d", addr, reason);
}

static struct bt_conn_auth_info_cb conn_auth_info_callbacks = {
	.pairing_complete = pairing_complete,
	.pairing_failed = pairing_failed,
};

/*




*/
/*AUTHENTICATION*/
static void auth_cancel(struct bt_conn *conn)
{
	char addr[BT_ADDR_LE_STR_LEN];

	bt_addr_le_to_str(bt_conn_get_dst(conn), addr, sizeof(addr));

	LOG_INF("Pairing cancelled: %s\n", addr);
}

static void passkey_confirm(struct bt_conn *conn, unsigned int passkey)
{
	bt_conn_auth_passkey_confirm(conn);
}

void passkey_display(struct bt_conn *conn, unsigned int passkey)
{
	LOG_INF("Controller passkey = %d", passkey);
}

static struct bt_conn_auth_cb auth_cb_display = {
	.passkey_display = passkey_display,
	.passkey_entry = NULL, // passkey_entry,
	.passkey_confirm = passkey_confirm,
	.cancel = auth_cancel,
};

/*




*/
/*SCANNING*/

static void scan_filter_match(struct bt_scan_device_info *device_info,
							  struct bt_scan_filter_match *filter_match,
							  bool connectable)
{
	char addr[BT_ADDR_LE_STR_LEN];

	bt_addr_le_to_str(device_info->recv_info->addr, addr, sizeof(addr));

	LOG_INF("Filters matched. Address: %s connectable: %d",
			addr, connectable);
}

static void scan_connecting_error(struct bt_scan_device_info *device_info)
{
	LOG_WRN("Connecting failed");
}

static void scan_connecting(struct bt_scan_device_info *device_info,
							struct bt_conn *conn)
{
	char addr[BT_ADDR_LE_STR_LEN];

	bt_addr_le_to_str(device_info->recv_info->addr, addr, sizeof(addr));
	LOG_INF("Scan connecting: %s", addr);
	DCLK_C_conn = bt_conn_ref(conn);
	// if (DCLK_C_conn == bt_conn_ref(conn))
	// {
	// 	LOG_INF("DCLK_C Connection Success");
	// }
}

BT_SCAN_CB_INIT(scan_cb, scan_filter_match, NULL,
				scan_connecting_error, scan_connecting);

static int scan_init(void)
{
	int err;
	struct bt_scan_init_param scan_init = {
		.connect_if_match = 1,
		.conn_param = NULL,
		.scan_param = NULL,
	};

	bt_scan_init(&scan_init);
	bt_scan_cb_register(&scan_cb);

	err = bt_scan_filter_add(BT_SCAN_FILTER_TYPE_UUID, BT_UUID_DCLK);
	if (err)
	{
		LOG_ERR("Scanning filters cannot be set (err %d)", err);
		return err;
	}

	err = bt_scan_filter_enable(BT_SCAN_UUID_FILTER, false);
	if (err)
	{
		LOG_ERR("Filters cannot be turned on (err %d)", err);
		return err;
	}

	LOG_INF("Scan module initialized");

	return err;
}
/*




*/
/*API*/
int dclk_client_init(struct dclk_client_cb *callbacks, unsigned int custom_passkey)
{

	int err;

	if (callbacks)
	{
		LOG_INF("DCLK callbacks set");
		DCLK_client.cb = *callbacks;
	}
	else
	{
		LOG_ERR("No DCLK callbacks set");
	}

	err = bt_enable(NULL);
	if (err)
	{
		LOG_ERR("Bluetooth enable failed (err %d)", err);
		return 0;
	}

	err = bt_conn_auth_cb_register(&auth_cb_display);
	if (err)
	{
		LOG_ERR("Bluetooth authentication register failed (err %d)\n", err);
		return 0;
	}

	err = bt_conn_auth_info_cb_register(&conn_auth_info_callbacks);
	if (err)
	{
		LOG_ERR("Bluetooth info register failed (err %d)\n", err);
		return 0;
	}

	if (IS_ENABLED(CONFIG_SETTINGS))
	{
		settings_load();

		LOG_INF("Settings Loaded Successfully\n");
	}
	else
	{
		LOG_INF("Could not load settings");
	}

	err = scan_init();
	if (err != 0)
	{
		LOG_ERR("scan_init failed (err %d)", err);
		return 0;
	}

	start_auto_connection();

	return 0;
}

int dclk_pairing(bool enable)
{
	stop_auto_connection();

	int err = bt_unpair(BT_ID_DEFAULT, BT_ADDR_LE_ANY);
	if (err)
	{
		LOG_INF("Cannot delete bond (err: %d)\n", err);
	}
	else
	{
		LOG_INF("Bond deleted succesfully \n");
	}

	while (!bt_is_ready())
	{
		LOG_INF("BT_NOT_READY");
	}

	start_auto_connection();

	return 0;
}
```

## src/DCLK_client.h
```c
#ifndef BT_DCLK_CLIENT_H_
#define BT_DCLK_CLIENT_H_

/**
 * @file
 * @defgroup DCLK_client Bluetooth LE GATT DCLK Client API
 * @{
 * @brief API for the Bluetooth LE DCLK Service (Client)
 */

#ifdef __cplusplus
extern "C"
{
#endif

#include <zephyr/types.h>
#include <zephyr/bluetooth/bluetooth.h>
#include <zephyr/bluetooth/hci.h>
#include <zephyr/bluetooth/conn.h>
#include <zephyr/bluetooth/uuid.h>
#include <zephyr/bluetooth/gatt.h>
#include <zephyr/sys/byteorder.h>
#include <bluetooth/gatt_dm.h>

#include <bluetooth/scan.h>

/** @brief DCLK Service UUID. */
#define BT_UUID_DCLK_VAL BT_UUID_128_ENCODE(0x00001553, 0x1212, 0xefde, 0x1523, 0x785feabcd123)

/** @brief State Characteristic UUID. */
#define BT_UUID_DCLK_STATE_VAL \
    BT_UUID_128_ENCODE(0x00001554, 0x1212, 0xefde, 0x1523, 0x785feabcd123)

/* STEP 11.1 - Assign a UUID to the MYSENSOR characteristic */
/** @brief Clock Characteristic UUID. */
#define BT_UUID_DCLK_CLOCK_VAL \
    BT_UUID_128_ENCODE(0x00001556, 0x1212, 0xefde, 0x1523, 0x785feabcd123)

#define BT_UUID_DCLK BT_UUID_DECLARE_128(BT_UUID_DCLK_VAL)
#define BT_UUID_DCLK_STATE BT_UUID_DECLARE_128(BT_UUID_DCLK_STATE_VAL)
#define BT_UUID_DCLK_CLOCK BT_UUID_DECLARE_128(BT_UUID_DCLK_CLOCK_VAL)

    /** @brief Handles on the connected peer device that are needed to interact with
     * the device.
     */
    struct dclk_client_handles
    {

        /** Handle of the DCLK dstate characteristic, as provided by
         *  a discovery.
         */
        uint16_t dstate;

        uint16_t dclock_ccc;

        /** Handle of the DCLK dclock characteristic, as provided by
         *  a discovery.
         */
        uint16_t dclock;

        uint16_t dstate_ccc;
    };

    /** @brief DCLK Client callback structure. */
    struct dclk_client_cb
    {
        /** @brief DCLK clock received callback.
         *
         * The data has been received as a notification of the DCLK clock
         * Characteristic.
         *
         * @param[in] clock_val received data.
         *
         * @retval BT_GATT_ITER_CONTINUE To keep notifications enabled.
         * @retval BT_GATT_ITER_STOP To disable notifications.
         */
        uint8_t (*received_clock)(uint32_t data);

        /** @brief DCLK state received callback.
         *
         * The data has been received as a notification of the DCLK state
         * Characteristic.
         *
         * @param[in] state_val recieved data.
         *
         * @retval BT_GATT_ITER_CONTINUE To keep notifications enabled.
         * @retval BT_GATT_ITER_STOP To disable notifications.
         */
        uint8_t (*received_state)(uint8_t data);

        /** @brief notifications disabled callback.
         *
         * notifications have been disabled.
         *
         * @param[in] DCLK  DCLK Client instance.
         */
        void (*unsubscribed)(struct bt_gatt_subscribe_params *params);
    };


    /** @brief DCLK Client structure. */
    struct dclk_client_t
    {

        /** Connection object. */
        struct bt_conn *conn;

        /** connection state. */
        atomic_t conn_state;

        /** Handles on the connected peer device that are needed
         * to interact with the device.
         */
        struct dclk_client_handles handles;

        /** GATT subscribe parameters for DCLK dclock Characteristic. */
        struct bt_gatt_subscribe_params dclock_notif_params;

        /** GATT write parameters for DCLK dstate Characteristic. */
        struct bt_gatt_subscribe_params dstate_notif_params;

        /** Application callbacks. */
        struct dclk_client_cb cb;
    };

    /** @brief Assign handles to the DCLK Client instance.
     *
     * This function should be called when a link with a peer has been established
     * to associate the link to this instance of the module. This makes it
     * possible to handle several links and associate each link to a particular
     * instance of this module. The GATT attribute handles are provided by the
     * GATT DB discovery module.
     *
     * @param[in] dm Discovery object.
     * @param[in,out] DCLK DCLK Client instance.
     *
     * @retval 0 If the operation was successful.
     * @retval (-ENOTSUP) Special error code used when UUID
     *         of the service does not match the expected UUID.
     * @retval Otherwise, a negative error code is returned.
     */



    int dclk_client_handles_assign(struct bt_gatt_dm *dm,
                                   struct dclk_client_t *DCLK);

    /** @brief Request the peer to start sending notifications for the dclock
     *	   Characteristic.
     *
     * This function enables notifications for the DCLK dclock Characteristic at the peer
     * by writing to the CCC descriptor of the DCLK dclock Characteristic.
     *
     * @param[in,out] DCLK DCLK Client instance.
     *
     * @retval 0 If the operation was successful.
     *           Otherwise, a negative error code is returned.
     */
    int dclk_client_subscribe(struct dclk_client_t *DCLK);

    /** @brief Initialize the DCLK Client module.
     *
     * This function initializes the DCLK Client module with callbacks provided by
     * the user.
     *
     * @param[in,out] callbacks callbacks for subscription events.
     * @param[in] custom_passkey a custom passkey for pairing.
     *
     * @retval 0 If the operation was successful.
     *           Otherwise, a negative error code is returned.
     */
    int dclk_client_init(struct dclk_client_cb *callbacks, unsigned int custom_passkey);


    
	/** @brief Enables/Disables advertizing and
	 * pairing of DCLK blueooth service
	 *
	 * This starts or stops advertizing immediately and
	 * sets the pairing state to enable
	 *
	 * @param[in] enable enables on true and disables on false
	 *
	 * @retval 0 If the operation was successful.
	 *           Otherwise, a (negative) error code is returned.
	 */
	int dclk_pairing(bool enable);


#ifdef __cplusplus
}
#endif

/**
 * @}
 */

#endif /* DCLK_CLIENT_H_ */
```
