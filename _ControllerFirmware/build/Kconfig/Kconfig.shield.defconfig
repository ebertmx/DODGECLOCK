## _ControllerFirmware/build/Kconfig/Kconfig.shield.defconfig
```kconfig
osource "c:/users/ebert/onedrive/projects/dodgeballclock/_controllerfirmware/boards/shields/*/Kconfig.defconfig"
osource "C:/ncs/v2.4.2/nrf/boards/shields/*/Kconfig.defconfig"
```

## _ControllerFirmware/build_1/Kconfig/Kconfig.shield
```kconfig
osource "c:/users/ebert/onedrive/projects/dodgeballclock/_controllerfirmware/boards/shields/*/Kconfig.shield"
osource "c:/users/ebert/onedrive/projects/dodgeballclock/_displayfirmware/boards/shields/*/Kconfig.shield"
osource "C:/ncs/v2.4.2/nrf/boards/shields/*/Kconfig.shield"
```

## _ControllerFirmware/build_1/Kconfig/Kconfig.shield.defconfig
```kconfig
osource "c:/users/ebert/onedrive/projects/dodgeballclock/_controllerfirmware/boards/shields/*/Kconfig.defconfig"
osource "c:/users/ebert/onedrive/projects/dodgeballclock/_displayfirmware/boards/shields/*/Kconfig.defconfig"
osource "C:/ncs/v2.4.2/nrf/boards/shields/*/Kconfig.defconfig"
```

## _RemoteFirmware/boards/arm/dclk32/Kconfig.board
```kconfig
# Copyright (c) 2024 Nordic Semiconductor ASA
# SPDX-License-Identifier: Apache-2.0

config BOARD_DCLK32
	bool "dclk32"
	depends on SOC_NRF52832_QFAA

	config BOARD_ENABLE_DCDC
	bool "Enable DCDC mode"
	select SOC_DCDC_NRF52X
	default n
	depends on BOARD_DCLK32
```

## _RemoteFirmware/boards/arm/dclk32/dclk32_defconfig
```kconfig
# Copyright (c) 2024 Nordic Semiconductor ASA
# SPDX-License-Identifier: Apache-2.0

CONFIG_SOC_SERIES_NRF52X=y
CONFIG_SOC_NRF52832_QFAA=y
CONFIG_BOARD_DCLK32=y

# Enable MPU
CONFIG_ARM_MPU=y

# Enable hardware stack protection
CONFIG_HW_STACK_PROTECTION=y

#Disable DCDC
CONFIG_BOARD_ENABLE_DCDC=n

#Config Reset
CONFIG_RESET_ON_FATAL_ERROR=y
CONFIG_GPIO_AS_PINRESET=n

#Set LF CLOCK
CONFIG_CLOCK_CONTROL_NRF_K32SRC_RC=y
CONFIG_CLOCK_CONTROL_NRF_K32SRC_XTAL=n
CONFIG_CLOCK_CONTROL_NRF_K32SRC_RC_CALIBRATION=y
CONFIG_CLOCK_CONTROL_NRF_K32SRC_500PPM=y
```

## _RemoteFirmware/build/Kconfig/Kconfig.shield
```kconfig
osource "c:/dev/dodgeballclock/_remotefirmware/boards/shields/*/Kconfig.shield"
osource "C:/ncs/v1.6.1/nrf/boards/shields/*/Kconfig.shield"
osource "C:/ncs/v1.6.1/zephyr/boards/shields/*/Kconfig.shield"
```

## _RemoteFirmware/build/Kconfig/Kconfig.shield.defconfig
```kconfig
osource "c:/dev/dodgeballclock/_remotefirmware/boards/shields/*/Kconfig.defconfig"
osource "C:/ncs/v1.6.1/nrf/boards/shields/*/Kconfig.defconfig"
osource "C:/ncs/v1.6.1/zephyr/boards/shields/*/Kconfig.defconfig"
```

## _RemoteFirmware/build/Kconfig/Kconfig.soc.arch
```kconfig
osource "C:/ncs/v1.6.1/zephyr/soc/$(ARCH)/Kconfig"
osource "C:/ncs/v1.6.1/zephyr/soc/$(ARCH)/*/Kconfig"
```

## boards/arm/dclk32/Kconfig.defconfig
```kconfig
# Copyright (c) 2024 Nordic Semiconductor ASA
# SPDX-License-Identifier: Apache-2.0

if BOARD_DCLK32

config BOARD
	default "dclk32"

config BT_CTLR
   default BT


endif
```

## build/Kconfig/Kconfig.shield.defconfig
```kconfig
osource "c:/users/ebert/onedrive/projects/dodgeballclock/_firmware/boards/shields/*/Kconfig.defconfig"
osource "C:/ncs/v2.4.2/nrf/boards/shields/*/Kconfig.defconfig"
```
